## config/west.yml
```yaml
manifest:
  remotes:
    - name: zmkfirmware
      url-base: https://github.com/zmkfirmware
  projects:
    - name: zmk
      remote: petejohanson
      revision: zephyr/test-bt-instant-passed-fix
      import: app/west.yml
  self:
    path: config
```
